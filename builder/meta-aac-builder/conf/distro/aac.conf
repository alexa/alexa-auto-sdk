## builder/meta-aac-builder/conf/distro/aac.conf
```bitbake
DISTRO = "aac"
DISTRO_NAME = "Alexa Auto SDK"
DISTRO_VERSION = "${@aac.get_version(d)}"
DISTRO_CODENAME = "${@aac.get_codename(d)}"

# Workarounds
USER_CLASSES = ""

# Use OpenSSL from host by default
AAC_ASSUME_PROVIDED ?= "^openssl$"
AAC_PKG_CONFIG_PROVIDED ?= "libcrypto"

# Use all cross-toolchain from host
ASSUME_PROVIDED += "\
    linux-libc-headers \
    virtual/${TARGET_PREFIX}gcc \
    virtual/${TARGET_PREFIX}binutils \
    virtual/${TARGET_PREFIX}libc-for-gcc \
    virtual/${TARGET_PREFIX}compilerlibs \
    virtual/libc \
    virtual/libiconv \
    ${AAC_ASSUME_PROVIDED} \
    "

# Our dedicated root path prefix
AAC_PREFIX ?= "/opt/AAC"
export prefix = "${AAC_PREFIX}"

# Skip these QA for now
ERROR_QA_remove = "file-rdeps"
WARN_QA_remove = "useless-rpaths host-user-contaminated"

# Use our pkgconfig logic
INHERIT += "aac-base"

# Use AVS Device SDK v1.19
PREFERRED_VERSION_avs-device-sdk ?= "1.19%"

# Debug build
IMAGE_GEN_DEBUGFS ?= "${@['0', '1'][d.getVar('DEBUG_BUILD') == '1']}"
PACKAGE_DEBUG_SPLIT_STYLE = "debug-without-src"

##################################################################
# Amazon Build Info
##################################################################

AMAZON_SOURCES ?= "${HOME}/amazon_sources"

PACKAGE_MACHINE ?= "${@[d.getVar('BUILD_SYS'), d.getVar('MACHINE')][d.getVar('MACHINE') != 'native']}"
```

## builder/meta-aac-builder/conf/distro/include/tclibc-android.inc
```bitbake
LIBCEXTENSION = "-android"

# Universal override for Android
MACHINEOVERRIDES = "android"

# Use dedicated tmpdir per API level
TCLIBCAPPEND = "-${ANDROID_PLATFORM}"

LIBC_DEPENDENCIES = ""

# Use OpenSSL 1.1+
# Note: This file will be loaded after default-versions.inc
#       so PREFERRED_VERSION for OpenSSL will be overridden.
PREFERRED_VERSION_openssl = "1.1%"
```

## builder/meta-aac-builder/conf/distro/include/tcmode-external.inc
```bitbake
# Default libc config
PREFERRED_PROVIDER_virtual/${TARGET_PREFIX}libc-for-gcc = "${TCLIBC}"
PREFERRED_PROVIDER_virtual/nativesdk-${SDK_PREFIX}libc-for-gcc ?= "nativesdk-glibc"
PREFERRED_PROVIDER_virtual/${TARGET_PREFIX}libc-initial = "${TCLIBC}-initial"
PREFERRED_PROVIDER_virtual/nativesdk-${SDK_PREFIX}libc-initial ?= "nativesdk-glibc-initial"
PREFERRED_PROVIDER_virtual/gettext ??= "gettext"

PREFERRED_VERSION_gzip-native ?= "1.8"
```

## builder/meta-aac-builder/conf/layer.conf
```bitbake
# We have a conf and classes directory, add to BBPATH
BBPATH .= ":${LAYERDIR}"

# We have recipes-* directories, add to BBFILES
BBFILES += "${LAYERDIR}/recipes-*/*/*.bb \
	${LAYERDIR}/recipes-*/*/*.bbappend"

BBFILE_COLLECTIONS += "aac-builder"
BBFILE_PATTERN_aac-builder = "^${LAYERDIR}/"
BBFILE_PRIORITY_aac-builder = "6"

AAC_HOSTTOOLS = "${LAYERDIR}/../hosttools"
```

## builder/meta-aac-builder/conf/machine/aglarm64.conf
```bitbake
#@TYPE: Machine
#@NAME: aglarm64
#@DESCRIPTION: AGL ARM64 target

DEFAULTTUNE = "aarch64"
require conf/machine/include/arm/arch-armv8.inc
require conf/machine/include/poky.inc

AGL_SDK ?= "/opt/agl-sdk/6.0.1-aarch64"
POKY_SDK ?= "${AGL_SDK}"
POKY_DISTRO = "agl"

TARGET_VENDOR = "-agl"

# Adding AGL universal override
MACHINEOVERRIDES = "${MACHINE}:agl"

# AGL Application Framework
AAC_ASSUME_PROVIDED_append = " af-binder"
AAC_PKG_CONFIG_PROVIDED_append = " afb-daemon"
```

## builder/meta-aac-builder/conf/machine/androidarm.conf
```bitbake
#@TYPE: Machine
#@NAME: androidarm
#@DESCRIPTION: Android ARMv7A (softfp with NEON) target

ANDROID_ABI = "armeabi-v7a"
DEFAULTTUNE = "armv7at-neon"
require conf/machine/include/arm/arch-armv7a.inc
require conf/machine/include/android.inc

# Workaround for NDK r20
CC = "armv7a${TARGET_VENDOR}-${TARGET_OS}${ANDROID_API_LEVEL}-clang"
CXX = "armv7a${TARGET_VENDOR}-${TARGET_OS}${ANDROID_API_LEVEL}-clang++"
CPP = "${CC} -E"
```

## builder/meta-aac-builder/conf/machine/androidarm64.conf
```bitbake
#@TYPE: Machine
#@NAME: androidarm64
#@DESCRIPTION: Android ARMv8A target

ANDROID_ABI = "arm64-v8a"

require conf/machine/include/arm/arch-armv8.inc
require conf/machine/include/android.inc

# Workaround for GNU ld:
# gold linker does not resolve symbols recursively, hence armv7a builds OK but
# since aarch64 still uses GNU ld, it builds fail without rpath-link option.
# Note: Once NDK supports LLD officially, this workaround will goes away...
EXTRA_OECMAKE += "-DCMAKE_EXE_LINKER_FLAGS="-Wl,-rpath-link,${STAGING_DIR_HOST}${libdir} -Wl,-rpath-link,${ANDROID_PLATFORM_LIBDIR}""
```

## builder/meta-aac-builder/conf/machine/include/agl.inc
```bitbake
# Common flags for AGL builds
# AGL Halibut (v8.0.0+) and above now use wireplumber audio

EXTRA_OECMAKE += "-DUSE_PIPEWIRE=ON"
```

## builder/meta-aac-builder/conf/machine/include/android.inc
```bitbake
# Android toolchain directory
# Needs to be setup via "setup-android-toolchain.sh" script
ANDROID_TOOLCHAIN ?= "${HOME}/android-toolchain"

# NDK Version
NDK_PACKAGE ?= "android-ndk-r20"

# API Level
ANDROID_API_LEVEL ?= "22"
ANDROID_PLATFORM = "android-${ANDROID_API_LEVEL}"

# NDK
ANDROID_NDK_HOME = "${ANDROID_TOOLCHAIN}/ndk/ndk-bundle/${NDK_PACKAGE}"

# Prebuilt Toolchain path
TOOLCHAIN = "${ANDROID_NDK_HOME}/toolchains/llvm/prebuilt/linux-x86_64"

TCLIBC = "android"
TCMODE = "external"

TARGET_VENDOR = ""

TARGET_SYSROOT = "${TOOLCHAIN}/sysroot"
ANDROID_PLATFORM_LIBDIR = "${TARGET_SYSROOT}/${libdir_native}/${TARGET_SYS}/${ANDROID_API_LEVEL}"

# CMake: https://developer.android.com/ndk/guides/cmake
#
# Note: CMake built-in NDK support is strongly discouraged by Google
#       thus we use toolchain file provided by NDK.
#
# Note: Specifying CMAKE_TOOLCHAIN_FILE in EXTRA_OECMAKE will override
#       existing variable, so it won't use a toolchain file that is
#       generated by OE-Core.
EXTRA_OECMAKE += "\
  -DANDROID_ABI="${ANDROID_ABI}" \
  -DANDROID_PLATFORM="${ANDROID_PLATFORM}" \
  -DANDROID_STL="c++_shared" \
  -DCMAKE_TOOLCHAIN_FILE="${ANDROID_NDK_HOME}/build/cmake/android.toolchain.cmake" \
  -DCMAKE_FIND_ROOT_PATH="${STAGING_DIR_HOST}" \
"

# No toolchain options
TOOLCHAIN_OPTIONS = ""

# Use Clang/LLVM
export CC = "${TARGET_SYS}${ANDROID_API_LEVEL}-clang"
export CXX = "${TARGET_SYS}${ANDROID_API_LEVEL}-clang++"
export CPP = "${CC} -E"

# Add toolchain path
PATH_prepend = "${TOOLCHAIN}/bin:"
EXTERNAL_TOOLCHAIN = "${TOOLCHAIN}"

# Tell configure what flags Android requires.
TARGET_CFLAGS = "-fPIE -fPIC"
TARGET_LDFLAGS = "-pie"

# Workaround
MODIFYTOS = "0"

# Android doesn't support versioning in SONAME
FILES_SOLIBSDEV = ""
SOLIBS = ".so"

# Use ABI/API name for image archive
ANDROID_MACHINE = "${ANDROID_ABI}-${ANDROID_PLATFORM}"
IMAGE_NAME = "${IMAGE_BASENAME}-${ANDROID_MACHINE}-${DATETIME}"
IMAGE_LINK_NAME = "${IMAGE_BASENAME}-${ANDROID_MACHINE}"

# Nothing are provided from host
AAC_ASSUME_PROVIDED = ""
AAC_PKG_CONFIG_PROVIDED = ""

##################################################################
# OE extra functions
##################################################################

def android_siteinfo_setfunc(archinfo, osinfo, targetinfo, d):
    osinfo['linux-android'] = "common-android"
    targetinfo['x86_64-linux-android'] = "bit-64"
    return archinfo, osinfo, targetinfo

SITEINFO_EXTRA_DATAFUNCS = "android_siteinfo_setfunc"

def android_get_machine_dict(machdata, d):
    machdata["linux-android"] = {
        "x86_64": (62,  0, 0, True, 64),
        "i686":   (3,   0, 0, True, 32),
        "aarch64":(183, 0, 0, True, 64),
    }
    machdata["linux-androideabi"] = {
        "arm" : (40, 0, 0, True, 32),
    }
    return machdata

PACKAGEQA_EXTRA_MACHDEFFUNCS = "android_get_machine_dict"
```

## builder/meta-aac-builder/conf/machine/include/linaro.inc
```bitbake
LINARO_TOOLCHAIN_PREFIX ?= "${HOME}/gcc-linaro-7.4.1-2019.02-"
LINARO_SYSROOTS ?= "${HOME}/sysroots"

TARGET_VENDOR = ""
TARGET_SYSROOT = "${LINARO_SYSROOTS}/${TARGET_SYS}"

EXTERNAL_TOOLCHAIN = "${LINARO_TOOLCHAIN_PREFIX}${BUILD_ARCH}_${TARGET_SYS}"

# CMake
OECMAKE_EXTRA_ROOT_PATH += "${TARGET_SYSROOT}"

# Add sysroot option
TOOLCHAIN_OPTIONS = " --sysroot=${TARGET_SYSROOT}"

# Add toolchain path
PATH_prepend = "${EXTERNAL_TOOLCHAIN}/bin:"

# Workaround
MODIFYTOS = "0"

# Assuming GStreamer is provided from host
AAC_PKG_CONFIG_PROVIDED_append = " gstreamer-1.0 gstreamer-app-1.0"
AAC_ASSUME_PROVIDED_append = " gstreamer1.0"

# pkg-config
export AAC_PKG_CONFIG_SYSROOT_DIR = "${TARGET_SYSROOT}"
export AAC_PKG_CONFIG_LIBDIR = "${TARGET_SYSROOT}/usr/lib/pkgconfig"
```

## builder/meta-aac-builder/conf/machine/include/poky.inc
```bitbake
POKY_SDK ??= "/opt/poky/2.6.1"
POKY_DISTRO ?= "poky"

TARGET_VENDOR = "-poky"
TARGET_SYSROOT = "${POKY_SDK}/sysroots/${MULTIMACH_TARGET_SYS}"
OECORE_NATIVE_SYSROOT = "${POKY_SDK}/sysroots/x86_64-${POKY_DISTRO}sdk-linux"

# Newer version of LD linker has some strange behavior: -rpath will be
# ignored to search indirect dependencies. Only -rpath-link seems to
# be working.
OECMAKE_C_LINK_FLAGS += "-Wl,-rpath-link,${STAGING_DIR_HOST}${libdir}"
OECMAKE_CXX_LINK_FLAGS += "-Wl,-rpath-link,${STAGING_DIR_HOST}${libdir}"

# CMake
OECMAKE_EXTRA_ROOT_PATH += "${TARGET_SYSROOT}"

# Use external OE toolchain
TOOLCHAIN_OPTIONS = " --sysroot=${TARGET_SYSROOT}"

# Add toolchain path
PATH_prepend = "${OECORE_NATIVE_SYSROOT}/usr/bin/${TARGET_SYS}:"
EXTERNAL_TOOLCHAIN = "${OECORE_NATIVE_SYSROOT}"

# Workaround
MODIFYTOS = "0"

# Assuming GStreamer is provided from host
AAC_PKG_CONFIG_PROVIDED_append = " gstreamer-1.0 gstreamer-app-1.0"
AAC_ASSUME_PROVIDED_append = " ^gstreamer1.0$"

# pkg-config
export AAC_PKG_CONFIG_SYSROOT_DIR = "${TARGET_SYSROOT}"
export AAC_PKG_CONFIG_LIBDIR = "${TARGET_SYSROOT}/usr/lib/pkgconfig"
```

## builder/meta-aac-builder/conf/machine/include/qnx7.inc
```bitbake
QNX_BASE ?= "${HOME}/qnx700"
QNX_ARCH ?= "x86_64"

export QNX_HOST = "${QNX_BASE}/host/linux/${BUILD_ARCH}"
export QNX_TARGET = "${QNX_BASE}/target/qnx7"
export QNX_CONFIGURATION = "${HOME}/.qnx"

TCLIBC = "qnx"
TCMODE = "external"

TARGET_OS = "nto-qnx7.0.0${ABIEXTENSION}"
TARGET_VENDOR = "${@bb.utils.contains_any('TARGET_ARCH', 'arm aarch64', '-unknown', '-pc', d)}"

# CMake
OECMAKE_EXTRA_ROOT_PATH += "${QNX_TARGET} ${QNX_TARGET}/${QNX_ARCH}"
AAC_CMAKE_SYSTEM_NAME = "QNX"

# No toolchain options
TOOLCHAIN_OPTIONS = ""

# Override tune args
TUNE_CCARGS = "-Vgcc_nto${QNX_ARCH}"

# Use QCC rather than GCC
export CC = "qcc ${TUNE_CCARGS}"
export CXX = "q++ ${TUNE_CCARGS}"
export CPP = "qcc ${TUNE_CCARGS} -E"

# Add toolchain path
PATH_prepend = "${QNX_HOST}/usr/bin:"
EXTERNAL_TOOLCHAIN = "${QNX_HOST}"

TARGET_CFLAGS = ""
# Use LLVM variant
TARGET_CXXFLAGS = " -Y_cxx"
TARGET_LDFLAGS = ""

# pkg-config
export AAC_PKG_CONFIG_SYSROOT_DIR = "${QNX_TARGET}"
export AAC_PKG_CONFIG_LIBDIR = "${AAC_HOSTTOOLS}/qnx7-pkgconfig/${QNX_ARCH}"

# Workaround
MODIFYTOS = "0"

##################################################################
# OE extra functions
##################################################################

def qnx7_siteinfo_setfunc(archinfo, osinfo, targetinfo, d):
    osinfo['nto-qnx7.0.0'] = "common-qnx"
    targetinfo['x86_64-nto-qnx7.0.0'] = "bit-64"
    return archinfo, osinfo, targetinfo

SITEINFO_EXTRA_DATAFUNCS = "qnx7_siteinfo_setfunc"

def qnx7_get_machine_dict(machdata, d):
    machdata["nto-qnx7.0.0"] = {
        "x86_64": (62,  0, 0, True, 64),
        "aarch64":(183, 0, 0, True, 64),
    }
    return machdata

PACKAGEQA_EXTRA_MACHDEFFUNCS = "qnx7_get_machine_dict"
```

## builder/meta-aac-builder/conf/machine/linaroarm64.conf
```bitbake
#@TYPE: Machine
#@NAME: linaroarm64
#@DESCRIPTION: Linaro ARM64 target

DEFAULTTUNE = "aarch64"

# Since AArch64 doesn't contains ABIEXTENSION, LIBCEXTENSION will be
# empty by default. But Linaro toolchain always requires -gnu extension.
LIBCEXTENSION_append = "-gnu"

require conf/machine/include/arm/arch-armv8.inc
require conf/machine/include/linaro.inc
```

## builder/meta-aac-builder/conf/machine/linaroarmel.conf
```bitbake
#@TYPE: Machine
#@NAME: linaroarmel
#@DESCRIPTION: Linaro ARMv7A w/NEON target

DEFAULTTUNE = "armv7at-neon"
require conf/machine/include/arm/arch-armv7a.inc
require conf/machine/include/linaro.inc
```

## builder/meta-aac-builder/conf/machine/linaroarmhf.conf
```bitbake
#@TYPE: Machine
#@NAME: linaroarmhf
#@DESCRIPTION: Linaro ARMv7A HardFloat w/NEON target

DEFAULTTUNE = "armv7athf-neon"

# ABIEXTENSION won't include hf suffix by default, but Linaro toolchain
# always requires the suffix.
ABIEXTENSION_append = "hf"

require conf/machine/include/arm/arch-armv7a.inc
require conf/machine/include/linaro.inc
```

## builder/meta-aac-builder/conf/machine/native.conf
```bitbake
#@TYPE: Machine
#@NAME: native
#@DESCRIPTION: native

DEFAULTTUNE = "core2-64"
require conf/machine/include/tune-core2.inc

# used by cmake class
OECMAKE_RPATH = "${libdir}"

TARGET_ARCH = "${BUILD_ARCH}"
TARGET_OS = "${BUILD_OS}"
TARGET_VENDOR = "${BUILD_VENDOR}"
TARGET_PREFIX = "${BUILD_PREFIX}"

# native pkg doesn't need the TOOLCHAIN_OPTIONS.
TOOLCHAIN_OPTIONS = ""

# set the compiler as well. It could have been set to something else
export CC = "${BUILD_CC}"
export CXX = "${BUILD_CXX}"
export FC = "${BUILD_FC}"
export CPP = "${BUILD_CPP}"
export LD = "${BUILD_LD}"
export CCLD = "${BUILD_CCLD}"
export AR = "${BUILD_AR}"
export AS = "${BUILD_AS}"
export RANLIB = "${BUILD_RANLIB}"
export STRIP = "${BUILD_STRIP}"
export NM = "${BUILD_NM}"

# Avoid confusion with class-native
MACHINEOVERRIDES = "machine-native"
MACHINE_FEATURES = ""

# No TCLIBCAPPEND
TCLIBCAPPEND = ""

# Assuming GStreamer is provided from host
AAC_PKG_CONFIG_PROVIDED_append = " gstreamer-1.0 gstreamer-app-1.0"
AAC_ASSUME_PROVIDED_append = " ^gstreamer1.0$"

# pkg-config
export AAC_PKG_CONFIG_SYSROOT_DIR = ""
export AAC_PKG_CONFIG_LIBDIR = "/usr/lib/pkgconfig:/usr/lib/x86_64-linux-gnu/pkgconfig:/usr/lib64/pkgconfig"
```

## builder/meta-aac-builder/conf/machine/pokyarm.conf
```bitbake
#@TYPE: Machine
#@NAME: pokyarm
#@DESCRIPTION: Poky Cortex-A8 HF w/NEON target

# Tested with official SDK image
# http://downloads.yoctoproject.org/releases/yocto/yocto-2.6.1/toolchain/x86_64/poky-glibc-x86_64-core-image-sato-cortexa8hf-neon-toolchain-2.6.1.sh
DEFAULTTUNE = "cortexa8hf-neon"
require conf/machine/include/tune-cortexa8.inc
require conf/machine/include/poky.inc
```

## builder/meta-aac-builder/conf/machine/pokyarm64.conf
```bitbake
#@TYPE: Machine
#@NAME: pokyarm64
#@DESCRIPTION: Poky ARM64 target

# Tested with official SDK image
# http://downloads.yoctoproject.org/releases/yocto/yocto-2.6.1/toolchain/x86_64/poky-glibc-x86_64-core-image-sato-aarch64-toolchain-2.6.1.sh
DEFAULTTUNE = "aarch64"
require conf/machine/include/arm/arch-armv8.inc
require conf/machine/include/poky.inc
```

## builder/meta-aac-builder/conf/machine/qnx7arm64.conf
```bitbake
#@TYPE: Machine
#@NAME: qnx7arm64
#@DESCRIPTION: QNX7 SDP ARM64LE target

# QNX_ARCH may be different from TUNE_ARCH
QNX_ARCH = "aarch64le"

DEFAULTTUNE = "aarch64"
require conf/machine/include/arm/arch-armv8.inc
require conf/machine/include/qnx7.inc

# Arch directory name may be different from QNX_ARCH
TARGET_SYSROOT = "${QNX_TARGET}/aarch64le"
```

## builder/meta-aac-builder/conf/machine/qnx7x86-64.conf
```bitbake
#@TYPE: Machine
#@NAME: qnx7x86-64
#@DESCRIPTION: QNX7 SDP x86_64 target

# QNX_ARCH may be different from TUNE_ARCH
QNX_ARCH = "x86_64"

DEFAULTTUNE = "core2-64"
require conf/machine/include/tune-core2.inc
require conf/machine/include/qnx7.inc

# Arch directory name may be different from QNX_ARCH
TARGET_SYSROOT = "${QNX_TARGET}/x86_64"
```
