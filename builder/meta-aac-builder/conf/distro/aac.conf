## builder/meta-aac-ubuntu/conf/layer.conf
```bitbake
# We have a conf and classes directory, add to BBPATH
BBPATH .= ":${LAYERDIR}"

# We have recipes-* directories, add to BBFILES
BBFILES += "${LAYERDIR}/recipes-*/*/*.bb \
	${LAYERDIR}/recipes-*/*/*.bbappend"

BBFILE_COLLECTIONS += "aac-ubuntu"
BBFILE_PATTERN_aac-ubuntu = "^${LAYERDIR}/"
BBFILE_PRIORITY_aac-ubuntu = "8"

# Extra packages from the host machine
# NOTE: OE is assuming pigz as default gzip provider
ASSUME_PROVIDED_append = "\
    quilt-native \
    dbus-native \
    xz-native \
    python3-native \
    elfutils-native \
    pigz-native \
    attr-native \
"

# Use programs from the host machine
HOSTTOOLS += "\
    quilt \
    xz \
"
```

## builder/meta-aac/conf/distro/aac.conf
```bitbake
DISTRO = "aac"
DISTRO_NAME = "Alexa Auto SDK"
DISTRO_VERSION ?= "1.0.0"
DISTRO_CODENAME ?= "elderberry"

# Workarounds
USER_CLASSES = ""

# Use all cross-toolchain from host
ASSUME_PROVIDED += "\
    linux-libc-headers \
    virtual/${TARGET_PREFIX}gcc \
    virtual/${TARGET_PREFIX}binutils \
    virtual/${TARGET_PREFIX}libc-for-gcc \
    virtual/${TARGET_PREFIX}compilerlibs \
    virtual/libc \
    virtual/libiconv \
    "

# Our dedicated root path prefix
export prefix = "/opt/AAC"

# Temporary location for release contents
releasedir = "${datadir}/aac_release"
FILES_${PN} += "${releasedir}"

# Skip these QA for now
ERROR_QA_remove = "file-rdeps"
WARN_QA_remove = "useless-rpaths host-user-contaminated"

# Use our pkgconfig logic
INHERIT += "aac-base"

# Use AVS Device SDK v1.7
PREFERRED_VERSION_avs-device-sdk ?= "1.7%"

# Debug build
OECMAKE_BUILD_TYPE = "${@['RELEASE', 'DEBUG'][d.getVar('DEBUG_BUILD') == '1']}"
IMAGE_GEN_DEBUGFS ?= "${@['0', '1'][d.getVar('DEBUG_BUILD') == '1']}"
PACKAGE_DEBUG_SPLIT_STYLE = "debug-without-src"
AAC_SENSITIVE_LOGS ?= "OFF"
AAC_LATENCY_LOGS ?= "OFF"

##################################################################
# Amazon Build Info
##################################################################

AMAZON_SOURCES ?= "${HOME}/amazon_sources"

PACKAGE_MACHINE ?= "${@[d.getVar('BUILD_SYS'), d.getVar('MACHINE')][d.getVar('MACHINE') != 'native']}"
```

## builder/meta-aac/conf/layer.conf
```bitbake
# We have a conf and classes directory, add to BBPATH
BBPATH .= ":${LAYERDIR}"

# We have recipes-* directories, add to BBFILES
BBFILES += "${LAYERDIR}/recipes-*/*/*.bb \
	${LAYERDIR}/recipes-*/*/*.bbappend"

BBFILE_COLLECTIONS += "aac"
BBFILE_PATTERN_aac = "^${LAYERDIR}/"
BBFILE_PRIORITY_aac = "6"
LAYERSERIES_COMPAT_aac = "rocko thud"

AAC_SCRIPTS_DIR = "${LAYERDIR}/../scripts"

# Import python aac module by default
OE_IMPORTS += "aac"

# Default installation path for AAC components
AAC_PREFIX ?= "${base_prefix}/opt/AAC"

# Default extra variables
AAC_BUILD_TYPE = "${@['RELEASE', 'DEBUG'][d.getVar('DEBUG_BUILD') == '1']}"
AAC_SENSITIVE_LOGS ?= "OFF"
AAC_LATENCY_LOGS ?= "OFF"
AAC_ENABLE_TESTS ?= "OFF"
```

## builder/meta-aac/conf/machine/aglarm64.conf
```bitbake
#@TYPE: Machine
#@NAME: aglarm64
#@DESCRIPTION: AGL ARM64 target

DEFAULTTUNE = "aarch64"
require conf/machine/include/arm/arch-armv8.inc
require conf/machine/include/agl.inc

##################################################################
# Amazon Build Info
##################################################################

OPENBLAS_TARGET = "CORTEXA57"
#KALDI_TARGET = "aarch64-oe-linux"
#PRYON_LITE_TARGET = "armv8a"
```
