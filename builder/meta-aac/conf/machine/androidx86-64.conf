## builder/meta-aac/conf/machine/androidx86-64.conf
```bitbake
#@TYPE: Machine
#@NAME: androidx86-64
#@DESCRIPTION: Android x86_64 target

ANDROID_ABI = "x86_64"

# x86_64 tune
DEFAULTTUNE = "core2-64"
require conf/machine/include/tune-core2.inc
require conf/machine/include/android.inc
```

## builder/meta-aac/conf/machine/androidx86.conf
```bitbake
#@TYPE: Machine
#@NAME: androidx86
#@DESCRIPTION: Android x86 target

ANDROID_ABI = "x86"

# i686 tune
require conf/machine/include/tune-core2.inc
require conf/machine/include/android.inc
```

## builder/meta-aac/conf/machine/include/agl.inc
```bitbake
TARGET_VENDOR = "-agl"

AGL_SDK ?= "/opt/poky-agl/5.1.0"

TARGET_SYSROOT = "${AGL_SDK}/sysroots/${TARGET_SYS}"
OECORE_NATIVE_SYSROOT = "${AGL_SDK}/sysroots/x86_64-aglsdk-linux"

# CMake
OECMAKE_EXTRA_ROOT_PATH += "${TARGET_SYSROOT}"
# Newer version of LD linker has some strange behavior: -rpath will be
# ignored to search indirect dependencies. Only -rpath-link seems to
# be working.
OECMAKE_C_LINK_FLAGS += "-Wl,-rpath-link,${STAGING_DIR_HOST}${libdir}"
OECMAKE_CXX_LINK_FLAGS += "-Wl,-rpath-link,${STAGING_DIR_HOST}${libdir}"

# Use external OE toolchain
TOOLCHAIN_OPTIONS = " --sysroot=${TARGET_SYSROOT}"

# Add toolchain path
PATH_prepend = "${OECORE_NATIVE_SYSROOT}/usr/bin/${TARGET_SYS}:"
EXTERNAL_TOOLCHAIN = "${OECORE_NATIVE_SYSROOT}"

# Adding AGL universal override
MACHINEOVERRIDES = "${MACHINE}:agl"

# Workaround
MODIFYTOS = "0"

##################################################################
# Qt5
##################################################################

QMAKE ?= "${OECORE_NATIVE_SYSROOT}/usr/bin/qt5/qmake"

export OE_QMAKE_CFLAGS = "${CFLAGS}"
export OE_QMAKE_CXXFLAGS = "${CXXFLAGS}"
export OE_QMAKE_LDFLAGS = "${LDFLAGS}"
export OE_QMAKE_CC = "${CC}"
export OE_QMAKE_CXX = "${CXX}"
export OE_QMAKE_LINK = "${CXX}"
export OE_QMAKE_AR = "${AR}"
export QT_CONF_PATH = "${OECORE_NATIVE_SYSROOT}/usr/bin/qt5/qt.conf"
export OE_QMAKE_LIBDIR_QT = "`${QMAKE} -query QT_INSTALL_LIBS`"
export OE_QMAKE_INCDIR_QT = "`${QMAKE} -query QT_INSTALL_HEADERS`"
export OE_QMAKE_MOC = "${OECORE_NATIVE_SYSROOT}/usr/bin/qt5/moc"
export OE_QMAKE_UIC = "${OECORE_NATIVE_SYSROOT}/usr/bin/qt5/uic"
export OE_QMAKE_RCC = "${OECORE_NATIVE_SYSROOT}/usr/bin/qt5/rcc"
export OE_QMAKE_QDBUSCPP2XML = "${OECORE_NATIVE_SYSROOT}/usr/bin/qt5/qdbuscpp2xml"
export OE_QMAKE_QDBUSXML2CPP = "${OECORE_NATIVE_SYSROOT}/usr/bin/qt5/qdbusxml2cpp"
export OE_QMAKE_QT_CONFIG = "`${QMAKE} -query QT_INSTALL_LIBS`/qt5/mkspecs/qconfig.pri"
export OE_QMAKE_PATH_HOST_BINS = "${OECORE_NATIVE_SYSROOT}/usr/bin/qt5"
export QMAKESPEC = "`${QMAKE} -query QT_INSTALL_LIBS`/qt5/mkspecs/linux-oe-g++"
```

## builder/meta-aac/conf/machine/include/android.inc
```bitbake
# Android toolchain directory
# Needs to be setup via "setup-android-toolchain.sh" script
ANDROID_TOOLCHAIN ?= "${HOME}/android-toolchain"

# NDK Version
NDK_PACKAGE ?= "android-ndk-r16b"

# API Level
ANDROID_PLATFORM ?= "android-22"

# Standalon Toolchain path
TOOLCHAIN = "${ANDROID_TOOLCHAIN}/ndk/toolchains/${NDK_PACKAGE}/toolchain-${ANDROID_ABI}/${ANDROID_PLATFORM}"

# NDK
ANDROID_NDK_HOME = "${ANDROID_TOOLCHAIN}/ndk/ndk-bundle/${NDK_PACKAGE}"

TCLIBC = "android"
TCMODE = "external"

TARGET_VENDOR = ""

TARGET_SYSROOT = "${TOOLCHAIN}/sysroot"

# CMake
# CMAKE_ANDROID_XXX options may be available in CMake 3.8 or later...
# e.g. -DCMAKE_ANDROID_STANDALONE_TOOLCHAIN=${TOOLCHAIN}
#      as well as -DCMAKE_SYSTEM_NAME="Android"
# ...But as of now, we will use NDK toolchain file.
#
# Note: Specifying CMAKE_TOOLCHAIN_FILE in EXTRA_OECMAKE will override
#       existing variable, so it won't use a toolchain file that is
#       generated by OE-Core.
EXTRA_OECMAKE += "\
  -DANDROID_ABI="${ANDROID_ABI}" \
  -DANDROID_ALLOW_UNDEFINED_SYMBOLS="FALSE" \
  -DANDROID_ARM_MODE="thumb" \
  -DANDROID_ARM_NEON="FALSE" \
  -DANDROID_CPP_FEATURES="rtti exceptions" \
  -DANDROID_DISABLE_FORMAT_STRING_CHECKS="FALSE" \
  -DANDROID_DISABLE_NO_EXECUTE="FALSE" \
  -DANDROID_DISABLE_RELRO="FALSE" \
  -DANDROID_PIE="ON" \
  -DANDROID_PLATFORM="${ANDROID_PLATFORM}" \
  -DANDROID_STL="c++_shared" \
  -DANDROID_TOOLCHAIN="clang" \
  -DCMAKE_TOOLCHAIN_FILE="${ANDROID_NDK_HOME}/build/cmake/android.toolchain.cmake" \
  -DCMAKE_FIND_ROOT_PATH="${STAGING_DIR_HOST}""

# No toolchain options
TOOLCHAIN_OPTIONS = ""

# Use Clang/LLVM
export CC = "${TARGET_PREFIX}clang"
export CXX = "${TARGET_PREFIX}clang++"
export CPP = "${TARGET_PREFIX}cpp"

# Add toolchain path
PATH_prepend = "${TOOLCHAIN}/bin:"
EXTERNAL_TOOLCHAIN = "${TOOLCHAIN}"

# Tell configure what flags Android requires.
TARGET_CFLAGS = "-fPIE -fPIC"
TARGET_LDFLAGS = "-pie"

# Workaround
MODIFYTOS = "0"

# Android doesn't support versioning in SONAME
FILES_SOLIBSDEV = ""
SOLIBS = ".so"

# Use ABI/API name for image archive
ANDROID_MACHINE = "${ANDROID_ABI}-${ANDROID_PLATFORM}"
IMAGE_NAME = "${IMAGE_BASENAME}-${ANDROID_MACHINE}-${DATETIME}"
IMAGE_LINK_NAME = "${IMAGE_BASENAME}-${ANDROID_MACHINE}"

# Nothing are provided from host
AAC_ASSUME_PROVIDED = ""
AAC_PKG_CONFIG_PROVIDED = ""

##################################################################
# OE extra functions
##################################################################

def android_siteinfo_setfunc(archinfo, osinfo, targetinfo, d):
    osinfo['linux-android'] = "common-android"
    targetinfo['x86_64-linux-android'] = "bit-64"
    return archinfo, osinfo, targetinfo

SITEINFO_EXTRA_DATAFUNCS = "android_siteinfo_setfunc"

def android_get_machine_dict(machdata, d):
    machdata["linux-android"] = {
        "x86_64": (62,  0, 0, True, 64),
        "i686":   (3,   0, 0, True, 32),
        "aarch64":(183, 0, 0, True, 64),
    }
    machdata["linux-androideabi"] = {
        "arm" : (40, 0, 0, True, 32),
    }
    return machdata

PACKAGEQA_EXTRA_MACHDEFFUNCS = "android_get_machine_dict"
```

## samples/audio/meta-aac-audio/conf/layer.conf
```bitbake
# We have a conf and classes directory, add to BBPATH
BBPATH .= ":${LAYERDIR}"

# We have recipes-* directories, add to BBFILES
BBFILES += "${LAYERDIR}/recipes-*/*/*.bb \
	${LAYERDIR}/recipes-*/*/*.bbappend"

BBFILE_COLLECTIONS += "aac-audio"
BBFILE_PATTERN_aac-audio = "^${LAYERDIR}/"
BBFILE_PRIORITY_aac-audio = "6"
```
